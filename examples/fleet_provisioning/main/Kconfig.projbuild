## examples/fleet_provisioning/main/Kconfig.projbuild
```kconfig
menu "Example Configuration"

    config MQTT_CLIENT_IDENTIFIER
        string "The MQTT client identifier used in this example"
        default "4UMCN4Jula"
        help
            The MQTT client identifier used in this example. Each client identifier must be unique.
            so edit as required to ensure that no two clients connecting to the same broker use the same client identifier.

    config MQTT_BROKER_ENDPOINT
        string "Endpoint of the MQTT broker to connect to"
        default "test.mosquitto.org"
        help
            This example can be run with any MQTT broker, that supports server authentication.

    config MQTT_BROKER_PORT
        int "Port of the MQTT broker use"
        default 8883
        help
            In general, port 8883 is for secured MQTT connections.
            Port 443 requires use of the ALPN TLS extension with the ALPN protocol name.
            When using port 8883, ALPN is not required.

    config HARDWARE_PLATFORM_NAME
        string "The hardware platform"
        default "ESP32"
        help
            The name of the hardware platform the application is running on.

    config MQTT_NETWORK_BUFFER_SIZE
        int "Size of the network buffer for MQTT packets"
        range 1024 2048
        default 1024
        help
            Size of the network buffer for MQTT packets.

    config PROVISIONING_TEMPLATE_NAME
        string "Name of the provisioning template"
        default "my_first_provisioning_template"
        help
            Name of the provisioning template to use for the RegisterThing
            portion of the Fleet Provisioning workflow.

    config DEVICE_SERIAL_NUMBER
        string "The device serial number"
        default "4UMCN4Jula"
        help
            This is sent as a parameter to the provisioning template,
            which uses it to generate a unique Thing name.
            This should be unique per device.

    choice EXAMPLE_CHOOSE_PKI_ACCESS_METHOD
        prompt "Choose PKI credentials access method"
        default EXAMPLE_USE_PLAIN_FLASH_STORAGE
        help
            ESP devices support multiple ways to secure store the PKI credentials.
            Currently Secure Element (ATECC608A) and DS peripheral are supported.
            The default behaviour is to access the PKI credentials which are embedded in the binary.
            Consult the ESP-TLS documentation in ESP-IDF Programming guide for more details.

        config EXAMPLE_USE_PLAIN_FLASH_STORAGE
        bool "Use flash storage (default)"
        help
            This option expects the Private key and Device certificate to be embedded in the binary.
            This is the default behaviour.
    endchoice

    choice EXAMPLE_PROV_TRANSPORT
        bool "Provisioning Transport"
        default EXAMPLE_PROV_TRANSPORT_SOFTAP if IDF_TARGET_ESP32S2
        default EXAMPLE_PROV_TRANSPORT_BLE
        help
            Wi-Fi provisioning component offers both, SoftAP and BLE transports. Choose any one.

        config EXAMPLE_PROV_TRANSPORT_BLE
            bool "BLE"
            select BT_ENABLED
            depends on !IDF_TARGET_ESP32S2
        config EXAMPLE_PROV_TRANSPORT_SOFTAP
            bool "Soft AP"
            select LWIP_IPV4
    endchoice

    choice EXAMPLE_PROV_SECURITY_VERSION
        bool "Protocomm security version"
        default EXAMPLE_PROV_SECURITY_VERSION_2
        help
            Wi-Fi provisioning component offers 3 security versions.
            The example offers a choice between security version 1 and 2.

        config EXAMPLE_PROV_SECURITY_VERSION_1
            bool "Security version 1"
            select ESP_PROTOCOMM_SUPPORT_SECURITY_VERSION_1

        config EXAMPLE_PROV_SECURITY_VERSION_2
            bool "Security version 2"
            select ESP_PROTOCOMM_SUPPORT_SECURITY_VERSION_2
    endchoice

    choice EXAMPLE_PROV_MODE
        bool "Security version 2 mode"
        depends on EXAMPLE_PROV_SECURITY_VERSION_2
        default EXAMPLE_PROV_SEC2_DEV_MODE

        config EXAMPLE_PROV_SEC2_DEV_MODE
            bool "Security version 2 development mode"
            depends on EXAMPLE_PROV_SECURITY_VERSION_2
            help
                This enables the development mode for
                security version 2.
                Please note that this mode is NOT recommended for production purpose.

        config EXAMPLE_PROV_SEC2_PROD_MODE
            bool "Security version 2 production mode"
            depends on EXAMPLE_PROV_SECURITY_VERSION_2
            help
                This enables the production mode for
                security version 2.
    endchoice

    config EXAMPLE_PROV_TRANSPORT
        int
        default 1 if EXAMPLE_PROV_TRANSPORT_BLE
        default 2 if EXAMPLE_PROV_TRANSPORT_SOFTAP

    config EXAMPLE_RESET_PROVISIONED
        bool
        default n
        prompt "Reset provisioned status of the device"
        help
            This erases the NVS to reset provisioned status of the device on every reboot.
            Provisioned status is determined by the Wi-Fi STA configuration, saved on the NVS.

    config EXAMPLE_RESET_PROV_MGR_ON_FAILURE
        bool
        default y
        prompt "Reset provisioned credentials and state machine after session failure"
        help
            Enable reseting provisioned credentials and state machine after session failure.
            This will restart the provisioning service after retries are exhausted.

    config EXAMPLE_PROV_MGR_MAX_RETRY_CNT
        int
        default 5
        prompt "Max retries before reseting provisioning state machine"
        depends on EXAMPLE_RESET_PROV_MGR_ON_FAILURE
        help
            Set the Maximum retry to avoid reconnecting to an inexistent AP or if credentials
            are misconfigured. Provisioned credentials are erased and internal state machine
            is reset after this threshold is reached.

    config EXAMPLE_PROV_SHOW_QR
        bool "Show provisioning QR code"
        default y
        help
            Show the QR code for provisioning.

    config EXAMPLE_PROV_USING_BLUEDROID
        bool
        depends on (BT_BLUEDROID_ENABLED && (IDF_TARGET_ESP32C3 || IDF_TARGET_ESP32S3))
        select BT_BLE_42_FEATURES_SUPPORTED
        default y
        help
            This enables BLE 4.2 features for Bluedroid.

    config EXAMPLE_REPROVISIONING
        bool "Re-provisioning"
        help
            Enable re-provisioning - allow the device to provision for new credentials
            after previous successful provisioning.
            
    choice EXAMPLE_LCD_CONTROLLER
        prompt "LCD controller model"
        default EXAMPLE_LCD_CONTROLLER_SSD1306
        help
            Select LCD controller model

        config EXAMPLE_LCD_CONTROLLER_SSD1306
            bool "SSD1306"

        config EXAMPLE_LCD_CONTROLLER_SH1107
            bool "SH1107"
    endchoice

endmenu
```
